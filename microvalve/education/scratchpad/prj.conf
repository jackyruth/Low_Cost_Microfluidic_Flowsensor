## CMakeLists.txt
```
cmake_minimum_required(VERSION 3.13.1)
find_package(Zephyr REQUIRED HINTS $ENV{ZEPHYR_BASE})
project(app LANGUAGES C VERSION 1.0.0)

target_sources(app PRIVATE src/main.c)
```

## Kconfig
```
menu "Zephyr"
source "Kconfig.zephyr"
endmenu

module = MICROVALVE
module-str = MICROVALVE
source "subsys/logging/Kconfig.template.log_config"
```

## prj.conf
```kconfig
CONFIG_PRINTK=y
CONFIG_SERIAL=y
CONFIG_UART_INTERRUPT_DRIVEN=y
CONFIG_CONSOLE_SUBSYS=y
CONFIG_CONSOLE_GETLINE=y
```

## src/main.c
```c
#include <stdio.h>
void main(){
	int c;
	while ((c = getchar()) != EOF){
		putchar(c);
	}
}
```
