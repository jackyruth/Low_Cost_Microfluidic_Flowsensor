## microvalve/boards/arm/custom_breakout/Kconfig.board
```kconfig
# STM32L432KC Nucleo board configuration

# Copyright (c) 2016 Open-RnD Sp. z o.o.
# Copyright (c) 2016 BayLibre, SAS
# SPDX-License-Identifier: Apache-2.0

config CUSTOM_BREAKOUT
	bool "Verdi L432KC Custom Breakout"
	depends on SOC_STM32L432XX
```

## microvalve/boards/arm/custom_breakout/Kconfig.defconfig
```kconfig
# STM32L432KC Nucleo board configuration

if BOARD_CUSTOM_BREAKOUT

config BOARD
	default "custom_breakout"

config SPI_STM32_INTERRUPT
	default y
	depends on SPI

endif # BOARD_CUSTOM_BREAKOUT
```

## microvalve/boards/arm/verdi_l432kb/Kconfig.board
```kconfig
config BOARD_VERDI_L432KB
    bool "Verdi L432KB Breakout Board"
    depends on SOC_STM32L432XX
```

## microvalve/boards/arm/verdi_l432kb/verdi_l432kb_defconfig
```kconfig
CONFIG_SOC_SERIES_STM32L4X=y
CONFIG_SOC_STM32L432XX=y

# Enable MPU
CONFIG_ARM_MPU=y

# Enable HW stack protection
CONFIG_HW_STACK_PROTECTION=y

# enable uart driver
CONFIG_SERIAL=y

# enable pinmux
CONFIG_PINMUX=y

# enable GPIO
CONFIG_GPIO=y

# console
CONFIG_CONSOLE=y
CONFIG_UART_CONSOLE=y


# Enable Clocks
CONFIG_CLOCK_CONTROL=y



# # Enable Clocks
# CONFIG_SYS_CLOCK_HW_CYCLES_PER_SEC=4000000
# CONFIG_CLOCK_CONTROL=y
# CONFIG_SYS_CLOCK_TICKS_PER_SEC=10000
# CONFIG_CLOCK_CONTROL_STM32_CUBE=y
# CONFIG_SYS_CLOCK_EXISTS=y
# CONFIG_SYSTEM_CLOCK_INIT_PRIORITY=0

# # CONFIG_HAS_STM32CUBE=y
# # CONFIG_USE_STM32_LL_EXTI=y
# # CONFIG_USE_STM32_LL_I2C=y
# # CONFIG_USE_STM32_LL_PWR=y
# # CONFIG_USE_STM32_LL_RCC=y
# # CONFIG_USE_STM32_LL_RTC=y
# # CONFIG_USE_STM32_LL_TIM=y
# # CONFIG_USE_STM32_LL_UTILS=y

# CONFIG_CLOCK_STM32_SYSCLK_SRC_MSI=y
# CONFIG_CLOCK_STM32_MSI_RANGE=6
# CONFIG_CLOCK_STM32_LSE=y
# CONFIG_CLOCK_STM32_MSI_PLL_MODE=y
# CONFIG_CLOCK_STM32_AHB_PRESCALER=1
# CONFIG_CLOCK_STM32_APB1_PRESCALER=1
# CONFIG_CLOCK_STM32_APB2_PRESCALER=1
# CONFIG_CLOCK_STM32_MCO1_SRC_NOCLOCK=y
# CONFIG_CLOCK_STM32_MCO2_SRC_NOCLOCK=y


# CONFIG_COUNTER=y
# CONFIG_COUNTER_RTC_STM32_CLOCK_LSE=y
# CONFIG_COUNTER_RTC_STM32_LSE_DRIVE_LOW=y
# CONFIG_COUNTER_RTC_STM32_BACKUP_DOMAIN_RESET=y

# CONFIG_ENTROPY_GENERATOR=y
# CONFIG_ENTROPY_STM32_RNG=y
```

## microvalve/west.yml
```yaml
manifest:
  self:
    path: microvalve

  remotes:
    - name: zephyrproject-rtos
      url-base: https://github.com/zephyrproject-rtos

  projects:
    - name: zephyr
      remote: zephyrproject-rtos
      revision: v2.6.0
      import: true
    # Other zephyr modules goes here
```
